// Device Tree Source for the Glimt board.
/dts-v1/;

/ {
    model = "Glimt example board";
    compatible = "example,glimt-board";
    #address-cells = <1>;

    memory@0 {
        device_type = "memory";
        reg = <0x0 42>;
    };
};
